## main/Kconfig.projbuild
```kconfig
menu "Example Configuration"

config STORE_HISTORY
    bool "Store command history in flash"
    default y
    help
        Linenoise line editing library provides functions to save and load
        command history. If this option is enabled, initalizes a FAT filesystem
        and uses it to store command history.

config WIFI_SSID
    string "WiFi SSID"
    default "myssid"
    help
        SSID (network name) for the example to connect to.

config WIFI_PASSWORD
    string "WiFi Password"
    default "mypassword"
    help
        WiFi password (WPA or WPA2) for the example to use.

        Can be left blank if the network has no security set.

config MQTT_CLIENT_ID
    string "AWS IoT Client ID"
    default "myesp32"
    help
        AWS IoT Client ID for the example. Should be unique for every device.

choice MQTT_CERT_SOURCE
    prompt "AWS IoT Certificate Source"
    default MQTT_EMBEDDED_CERTS
    help
       AWS IoT requires loading of a device-specific certificate and private key,
       and a common Root CA Certificate. These can be compiled into the example
       app, or they can be loaded via the filesystem from an SD card.

config MQTT_EMBEDDED_CERTS
    bool "Embed into app"
config MQTT_SDCARD_CERTS
    bool "Load from SD card"
    select MQTT_FILESYSTEM_CERTS
endchoice

# Currently this is equivalent to MQTT_SDCARD_CERTS,
# however eventually we want to support more filesystem
# sources (SPIFFS, etc.) So this hidden config item
# is selected whenever the item should load from filesystem.
config MQTT_FILESYSTEM_CERTS
    bool

config MQTT_CERTIFICATE_PATH
    string "Device Certificate Path"
    depends on MQTT_FILESYSTEM_CERTS
    default "/sdcard/certificate.pem.crt"

config MQTT_PRIVATE_KEY_PATH
    string "Device Private Key Path"
    depends on MQTT_FILESYSTEM_CERTS
    default "/sdcard/private.pem.key"

config MQTT_ROOT_CA_PATH
    string "Root CA Certificate Path"
    depends on MQTT_FILESYSTEM_CERTS
    default "/sdcard/aws-root-ca.pem"

endmenu
```
